## tinatest/config/base/audio/Config.in
```kconfig
menuconfig TINATEST_BASE_AUDIO
    bool "audio"

if TINATEST_BASE_AUDIO
    source codec/Config.in
endif
```

## tinatest/config/base/audio/codec/Config.in
```kconfig
menuconfig TINATEST_BASE_AUDIO_CODEC
    bool "codec"

if TINATEST_BASE_AUDIO_CODEC
    source playback_bits_supported/Config.in
    source playback_rate_supported/Config.in
    source playback_rate_verify/Config.in
    source capture_bits_supported/Config.in
    source capture_rate_supported/Config.in
    source headphone_playback/Config.in
    source headphone_volume_adjust/Config.in
    source speaker_playback/Config.in
    source speaker_volume_adjust/Config.in
    source lineout_playback/Config.in
    source lineout_volume_adjust/Config.in
    source mic_capture/Config.in
    source mic_volume_adjust/Config.in
    source linein_capture/Config.in
    source phonein_capture/Config.in
endif
```

## tinatest/config/base/audio/codec/playback_rate_supported/Config.in
```kconfig
menuconfig TINATEST_BASE_AUDIO_CODEC_PLAYBACK_RATE_SUPPORTED_ENABLE
    bool "playback_rate_supported"
    default n
    select PACKAGE_alsa-ucm-aw-utils
    select PACKAGE_alsa-utils
    ---help---
        Settings for /base/audio/codec/playback_rate_supported
        It safe to leave a blank for any settings.
        If not setted, TinaTest will use global settings or default settings instead.

if TINATEST_BASE_AUDIO_CODEC_PLAYBACK_RATE_SUPPORTED_ENABLE
    config TINATEST_BASE_AUDIO_CODEC_PLAYBACK_RATE_SUPPORTED_COMMAND
        string "command"
        default "codec_playback_rate_supported.sh"
        ---help---
            TinaTest will run this command to start testcase.
            It is the same as shell command which followed by argumemts.
            This setting is a mark of any testcase.

    config TINATEST_BASE_AUDIO_CODEC_PLAYBACK_RATE_SUPPORTED_STDIN
        string "stdin"
        default ""
        ---help---
            Redirect a string array, which is setted in this configure, to standard input.
            For example,
            "one two three four" is equivalent to enter 4 times to testcase every run_time.
            The first time, enter "one" with new line,
            the second time, enter "two" with new line, and so on.

    config TINATEST_BASE_AUDIO_CODEC_PLAYBACK_RATE_SUPPORTED_FSTDIN
        string "fstdin"
        default ""
        ---help---
            Redirect a file, which is setted in this configure, to standard input.

    comment "<N> to Default && <Y> to customize"
    config TINATEST_BASE_AUDIO_CODEC_PLAYBACK_RATE_SUPPORTED_INFO
        bool "INFO"
        default y

    if TINATEST_BASE_AUDIO_CODEC_PLAYBACK_RATE_SUPPORTED_INFO
        config TINATEST_BASE_AUDIO_CODEC_PLAYBACK_RATE_SUPPORTED_DATE
            bool "date"
            default y if TINATEST_SYS_LOCAL_INFO_DATE
            ---help---
                Save running date and time.

        config TINATEST_BASE_AUDIO_CODEC_PLAYBACK_RATE_SUPPORTED_RESOURCE
            bool "resource"
            default y if TINATEST_SYS_LOCAL_INFO_RESOURCE
            ---help---
                Save resources for each testcase.

        config TINATEST_BASE_AUDIO_CODEC_PLAYBACK_RATE_SUPPORTED_REAL_TIME_LOG
            bool "real_time_log"
            default y if TINATEST_SYS_LOCAL_INFO_REAL_TIME_LOG
            ---help---
                Print log of testcase real time.
                In default, tinatest just collect all log, and print them when testcase end.
    endif

    comment "<N> to Default && <Y> to customize"
    config TINATEST_BASE_AUDIO_CODEC_PLAYBACK_RATE_SUPPORTED_LIMIT
        bool "LIMIT"
        default y

    if TINATEST_BASE_AUDIO_CODEC_PLAYBACK_RATE_SUPPORTED_LIMIT
        config TINATEST_BASE_AUDIO_CODEC_PLAYBACK_RATE_SUPPORTED_RUN_TIMES
            string "run_times"
            default ""
            ---help---
                The times to run testcase.
                For example:
                To run this testcase for 3 times, we can set this value as 3.

        config TINATEST_BASE_AUDIO_CODEC_PLAYBACK_RATE_SUPPORTED_RUN_ALONE
            bool "run_alone"
            default y
            ---help---
                Wait for finishing all previous testcase and run alone before do next.

        config TINATEST_BASE_AUDIO_CODEC_PLAYBACK_RATE_SUPPORTED_RUN_PARALLEL
            bool "run_parallel"
            default n
            ---help---
                Run parallel for all run_times.
                For example:
                Testcae will run for 3 times one by one if run_times=3.
                However, if run_parallel is setted, tinatest will creates 3 processers in one time.

        config TINATEST_BASE_AUDIO_CODEC_PLAYBACK_RATE_SUPPORTED_MAY_REBOOT
            bool "may_reboot"
            default y if TINATEST_SYS_LOCAL_LIMIT_MAY_REBOOT
            ---help---
                It means that device will be rebooted while running testcase.
                All states of testcase will be saved in flash, and loaded after rebooting.
                Notices that, if may_reboot is setted, run_alone will be setted alway.

        config TINATEST_BASE_AUDIO_CODEC_PLAYBACK_RATE_SUPPORTED_TESTCASE_RUN_ONCE_TIME
            string "testcase_run_once_time"
            default ""
            ---help---
                Time limit for testcase to run once.
                It is in format:
                    <sec> <min> <hour> <day>
                For example,
                100s : 100
                1m20s : 20 1 (or 80)
                1d3h : 0 0 3 1 (or 0 0 28 or other)

        config TINATEST_BASE_AUDIO_CODEC_PLAYBACK_RATE_SUPPORTED_TESTCASE_RUN_TIME
            string "testcase_run_time"
            default ""
            ---help---
                Time limit for testcase to run.
                It is in format:
                    <sec> <min> <hour> <day>
                For example,
                100s : 100
                1m20s : 20 1 (or 80)
                1d3h : 0 0 3 1 (or 0 0 28 or other)

        choice
            prompt "timeout_with"
            default TINATEST_BASE_AUDIO_CODEC_PLAYBACK_RATE_SUPPORTED_TIMEOUT_WITH_PASS
            ---help---
                The result when testcase exit for timeout.

            config TINATEST_BASE_AUDIO_CODEC_PLAYBACK_RATE_SUPPORTED_TIMEOUT_WITH_PASS
                bool "pass"

            config TINATEST_BASE_AUDIO_CODEC_PLAYBACK_RATE_SUPPORTED_TIMEOUT_WITH_FAILED
                bool "failed"
        endchoice

        config TINATEST_BASE_AUDIO_CODEC_PLAYBACK_RATE_SUPPORTED_EXIT_ONCE_FAILED
            bool "exit_once_failed"
            default n
            ---help---
                Stop running testcase and exit once failed, even if runned times less than run_times.
    endif

    config TINATEST_BASE_AUDIO_CODEC_PLAYBACK_RATE_SUPPORTED_PLAYBACK_VOLUME
        int "playback_volume"

    config TINATEST_BASE_AUDIO_CODEC_PLAYBACK_RATE_SUPPORTED_RATE_8000
        bool "rate_8000"
        default y

    config TINATEST_BASE_AUDIO_CODEC_PLAYBACK_RATE_SUPPORTED_RATE_11025
        bool "rate_11025"
        default y

    config TINATEST_BASE_AUDIO_CODEC_PLAYBACK_RATE_SUPPORTED_RATE_16000
        bool "rate_16000"
        default y

    config TINATEST_BASE_AUDIO_CODEC_PLAYBACK_RATE_SUPPORTED_RATE_22050
        bool "rate_22050"
        default y

    config TINATEST_BASE_AUDIO_CODEC_PLAYBACK_RATE_SUPPORTED_RATE_24000
        bool "rate_24000"
        default y

    config TINATEST_BASE_AUDIO_CODEC_PLAYBACK_RATE_SUPPORTED_RATE_32000
        bool "rate_32000"
        default y

    config TINATEST_BASE_AUDIO_CODEC_PLAYBACK_RATE_SUPPORTED_RATE_44100
        bool "rate_44100"
        default y

    config TINATEST_BASE_AUDIO_CODEC_PLAYBACK_RATE_SUPPORTED_RATE_48000
        bool "rate_48000"
        default y

    config TINATEST_BASE_AUDIO_CODEC_PLAYBACK_RATE_SUPPORTED_RATE_88200
        bool "rate_88200"
        default y

    config TINATEST_BASE_AUDIO_CODEC_PLAYBACK_RATE_SUPPORTED_RATE_96000
        bool "rate_96000"
        default y

    config TINATEST_BASE_AUDIO_CODEC_PLAYBACK_RATE_SUPPORTED_RATE_176400
        bool "rate_176400"
        default y

    config TINATEST_BASE_AUDIO_CODEC_PLAYBACK_RATE_SUPPORTED_RATE_192000
        bool "rate_192000"
        default y

    config TINATEST_BASE_AUDIO_CODEC_PLAYBACK_RATE_SUPPORTED_WAV_DIR
        string "wav_dir"
        default "/mnt/exUDISK/audio_wav/common"

    config TINATEST_BASE_AUDIO_CODEC_PLAYBACK_RATE_SUPPORTED_RATE_8000_WAV_FILE
        string "rate_8000_wav_file"
        default "8000-stereo-s16_le-10s.wav"

    config TINATEST_BASE_AUDIO_CODEC_PLAYBACK_RATE_SUPPORTED_RATE_11025_WAV_FILE
        string "rate_11025_wav_file"
        default "11025-stereo-s16_le-10s.wav"

    config TINATEST_BASE_AUDIO_CODEC_PLAYBACK_RATE_SUPPORTED_RATE_16000_WAV_FILE
        string "rate_16000_wav_file"
        default "16000-stereo-s16_le-10s.wav"

    config TINATEST_BASE_AUDIO_CODEC_PLAYBACK_RATE_SUPPORTED_RATE_22050_WAV_FILE
        string "rate_22050_wav_file"
        default "22050-stereo-s16_le-10s.wav"

    config TINATEST_BASE_AUDIO_CODEC_PLAYBACK_RATE_SUPPORTED_RATE_24000_WAV_FILE
        string "rate_24000_wav_file"
        default "24000-stereo-s16_le-10s.wav"

    config TINATEST_BASE_AUDIO_CODEC_PLAYBACK_RATE_SUPPORTED_RATE_32000_WAV_FILE
        string "rate_32000_wav_file"
        default "32000-stereo-s16_le-10s.wav"

    config TINATEST_BASE_AUDIO_CODEC_PLAYBACK_RATE_SUPPORTED_RATE_44100_WAV_FILE
        string "rate_44100_wav_file"
        default "44100-stereo-s16_le-10s.wav"

    config TINATEST_BASE_AUDIO_CODEC_PLAYBACK_RATE_SUPPORTED_RATE_48000_WAV_FILE
        string "rate_48000_wav_file"
        default "48000-stereo-s16_le-10s.wav"

    config TINATEST_BASE_AUDIO_CODEC_PLAYBACK_RATE_SUPPORTED_RATE_88200_WAV_FILE
        string "rate_88200_wav_file"
        default "88200-stereo-s16_le-10s.wav"

    config TINATEST_BASE_AUDIO_CODEC_PLAYBACK_RATE_SUPPORTED_RATE_96000_WAV_FILE
        string "rate_96000_wav_file"
        default "96000-stereo-s16_le-10s.wav"

    config TINATEST_BASE_AUDIO_CODEC_PLAYBACK_RATE_SUPPORTED_RATE_176400_WAV_FILE
        string "rate_176400_wav_file"
        default "176400-stereo-s16_le-10s.wav"

    config TINATEST_BASE_AUDIO_CODEC_PLAYBACK_RATE_SUPPORTED_RATE_192000_WAV_FILE
        string "rate_192000_wav_file"
        default "192000-stereo-s16_le-10s.wav"
endif
```
