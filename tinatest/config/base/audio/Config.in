## tinatest/config/base/audio/codec/speaker_volume_adjust/Config.in
```kconfig
menuconfig TINATEST_BASE_AUDIO_CODEC_SPEAKER_VOLUME_ADJUST_ENABLE
    bool "speaker_volume_adjust"
    default n
    select PACKAGE_alsa-ucm-aw-utils
    select PACKAGE_alsa-utils
    ---help---
        Settings for /base/audio/codec/speaker_volume_adjust
        It safe to leave a blank for any settings.
        If not setted, TinaTest will use global settings or default settings instead.

if TINATEST_BASE_AUDIO_CODEC_SPEAKER_VOLUME_ADJUST_ENABLE
    config TINATEST_BASE_AUDIO_CODEC_SPEAKER_VOLUME_ADJUST_COMMAND
        string "command"
        default "codec_speaker_volume_adjust.sh"
        ---help---
            TinaTest will run this command to start testcase.
            It is the same as shell command which followed by argumemts.
            This setting is a mark of any testcase.

    config TINATEST_BASE_AUDIO_CODEC_SPEAKER_VOLUME_ADJUST_STDIN
        string "stdin"
        default ""
        ---help---
            Redirect a string array, which is setted in this configure, to standard input.
            For example,
            "one two three four" is equivalent to enter 4 times to testcase every run_time.
            The first time, enter "one" with new line,
            the second time, enter "two" with new line, and so on.

    config TINATEST_BASE_AUDIO_CODEC_SPEAKER_VOLUME_ADJUST_FSTDIN
        string "fstdin"
        default ""
        ---help---
            Redirect a file, which is setted in this configure, to standard input.

    comment "<N> to Default && <Y> to customize"
    config TINATEST_BASE_AUDIO_CODEC_SPEAKER_VOLUME_ADJUST_INFO
        bool "INFO"
        default y

    if TINATEST_BASE_AUDIO_CODEC_SPEAKER_VOLUME_ADJUST_INFO
        config TINATEST_BASE_AUDIO_CODEC_SPEAKER_VOLUME_ADJUST_DATE
            bool "date"
            default y if TINATEST_SYS_LOCAL_INFO_DATE
            ---help---
                Save running date and time.

        config TINATEST_BASE_AUDIO_CODEC_SPEAKER_VOLUME_ADJUST_RESOURCE
            bool "resource"
            default y if TINATEST_SYS_LOCAL_INFO_RESOURCE
            ---help---
                Save resources for each testcase.

        config TINATEST_BASE_AUDIO_CODEC_SPEAKER_VOLUME_ADJUST_REAL_TIME_LOG
            bool "real_time_log"
            default y if TINATEST_SYS_LOCAL_INFO_REAL_TIME_LOG
            ---help---
                Print log of testcase real time.
                In default, tinatest just collect all log, and print them when testcase end.
    endif

    comment "<N> to Default && <Y> to customize"
    config TINATEST_BASE_AUDIO_CODEC_SPEAKER_VOLUME_ADJUST_LIMIT
        bool "LIMIT"
        default y

    if TINATEST_BASE_AUDIO_CODEC_SPEAKER_VOLUME_ADJUST_LIMIT
        config TINATEST_BASE_AUDIO_CODEC_SPEAKER_VOLUME_ADJUST_RUN_TIMES
            string "run_times"
            default ""
            ---help---
                The times to run testcase.
                For example:
                To run this testcase for 3 times, we can set this value as 3.

        config TINATEST_BASE_AUDIO_CODEC_SPEAKER_VOLUME_ADJUST_RUN_ALONE
            bool "run_alone"
            default y
            ---help---
                Wait for finishing all previous testcase and run alone before do next.

        config TINATEST_BASE_AUDIO_CODEC_SPEAKER_VOLUME_ADJUST_RUN_PARALLEL
            bool "run_parallel"
            default n
            ---help---
                Run parallel for all run_times.
                For example:
                Testcae will run for 3 times one by one if run_times=3.
                However, if run_parallel is setted, tinatest will creates 3 processers in one time.

        config TINATEST_BASE_AUDIO_CODEC_SPEAKER_VOLUME_ADJUST_MAY_REBOOT
            bool "may_reboot"
            default y if TINATEST_SYS_LOCAL_LIMIT_MAY_REBOOT
            ---help---
                It means that device will be rebooted while running testcase.
                All states of testcase will be saved in flash, and loaded after rebooting.
                Notices that, if may_reboot is setted, run_alone will be setted alway.

        config TINATEST_BASE_AUDIO_CODEC_SPEAKER_VOLUME_ADJUST_TESTCASE_RUN_ONCE_TIME
            string "testcase_run_once_time"
            default ""
            ---help---
                Time limit for testcase to run once.
                It is in format:
                    <sec> <min> <hour> <day>
                For example,
                100s : 100
                1m20s : 20 1 (or 80)
                1d3h : 0 0 3 1 (or 0 0 28 or other)

        config TINATEST_BASE_AUDIO_CODEC_SPEAKER_VOLUME_ADJUST_TESTCASE_RUN_TIME
            string "testcase_run_time"
            default ""
            ---help---
                Time limit for testcase to run.
                It is in format:
                    <sec> <min> <hour> <day>
                For example,
                100s : 100
                1m20s : 20 1 (or 80)
                1d3h : 0 0 3 1 (or 0 0 28 or other)

        choice
            prompt "timeout_with"
            default TINATEST_BASE_AUDIO_CODEC_SPEAKER_VOLUME_ADJUST_TIMEOUT_WITH_PASS
            ---help---
                The result when testcase exit for timeout.

            config TINATEST_BASE_AUDIO_CODEC_SPEAKER_VOLUME_ADJUST_TIMEOUT_WITH_PASS
                bool "pass"

            config TINATEST_BASE_AUDIO_CODEC_SPEAKER_VOLUME_ADJUST_TIMEOUT_WITH_FAILED
                bool "failed"
        endchoice

        config TINATEST_BASE_AUDIO_CODEC_SPEAKER_VOLUME_ADJUST_EXIT_ONCE_FAILED
            bool "exit_once_failed"
            default n
            ---help---
                Stop running testcase and exit once failed, even if runned times less than run_times.
    endif

    config TINATEST_BASE_AUDIO_CODEC_SPEAKER_VOLUME_ADJUST_PLAYBACK_REPEAT_TIMES
        int "playback_repeat_times"
        default 1

    config TINATEST_BASE_AUDIO_CODEC_SPEAKER_VOLUME_ADJUST_VOLUME_ADJUST_STEP
        int "volume_adjust_step"
        default 7

    config TINATEST_BASE_AUDIO_CODEC_SPEAKER_VOLUME_ADJUST_VOLUME_ADJUST_INTERVAL_SEC
        int "volume_adjust_interval_sec"
        default 1

    config TINATEST_BASE_AUDIO_CODEC_SPEAKER_VOLUME_ADJUST_WAV_DIR
        string "wav_dir"
        default "/mnt/exUDISK/audio_wav/sine_signals"

    config TINATEST_BASE_AUDIO_CODEC_SPEAKER_VOLUME_ADJUST_WAV_FILE
        string "wav_file"
        default "44100-sine-1khz-stereo-s16_le-15s.wav"
endif
```

## tinatest/config/base/display/Config.in
```kconfig
menuconfig TINATEST_BASE_DISPLAY
    bool "display"

if TINATEST_BASE_DISPLAY
    source displyiftester/Config.in
endif
```

## tinatest/config/base/production/wifi/Config.in
```kconfig
menuconfig TINATEST_BASE_PRODUCTION_WIFI
    bool "wifi"
    default y

if TINATEST_BASE_PRODUCTION_WIFI
    source wifitester/Config.in
    source rt_wifitester/Config.in
endif
```

## tinatest/config/base/storage/Config.in
```kconfig
menuconfig TINATEST_BASE_STORAGE
    bool "storage"

if TINATEST_BASE_STORAGE
    source hotplug/Config.in
endif
```

## tinatest/config/base/wifi/Config.in
```kconfig
menuconfig TINATEST_BASE_WIFI
    bool "wifi"

if TINATEST_BASE_WIFI
    source wificonnect/Config.in
    source wifiscan/Config.in
endif
```

## tinatest/config/stress/cpu/Config.in
```kconfig
menuconfig TINATEST_STRESS_CPU
    bool "cpu"

if TINATEST_STRESS_CPU
    source cpufreq/Config.in
    source cpuhotplug/Config.in
    source cpucalc/Config.in
endif
```

## tinatest/config/stress/standby/Config.in
```kconfig
menuconfig TINATEST_STRESS_STANDBY_ENABLE
    bool "standby"
    default n
    ---help---
        Settings for /stress/standby
        It safe to leave a blank for any settings.
        If not setted, TinaTest will use global settings or default settings instead.

if TINATEST_STRESS_STANDBY_ENABLE
    config TINATEST_STRESS_STANDBY_COMMAND
        string "command"
        default "standby.sh"
        ---help---
            TinaTest will run this command to start testcase.
            It is the same as shell command which followed by argumemts.
            This setting is a mark of any testcase.

    config TINATEST_STRESS_STANDBY_STDIN
        string "stdin"
        default ""
        ---help---
            Redirect a string array, which is setted in this configure, to standard input.
            For example,
            "one two three four" is equivalent to enter 4 times to testcase every run_time.
            The first time, enter "one" with new line,
            the second time, enter "two" with new line, and so on.

    config TINATEST_STRESS_STANDBY_FSTDIN
        string "fstdin"
        default ""
        ---help---
            Redirect a file, which is setted in this configure, to standard input.

    comment "<N> to Default && <Y> to customize"
    config TINATEST_STRESS_STANDBY_INFO
        bool "INFO"
        default y

    if TINATEST_STRESS_STANDBY_INFO
        config TINATEST_STRESS_STANDBY_DATE
            bool "date"
            default y if TINATEST_SYS_LOCAL_INFO_DATE
            ---help---
                Save running date and time.

        config TINATEST_STRESS_STANDBY_RESOURCE
            bool "resource"
            default y if TINATEST_SYS_LOCAL_INFO_RESOURCE
            ---help---
                Save resources for each testcase.

        config TINATEST_STRESS_STANDBY_REAL_TIME_LOG
            bool "real_time_log"
            default y if TINATEST_SYS_LOCAL_INFO_REAL_TIME_LOG
            ---help---
                Print log of testcase real time.
                In default, tinatest just collect all log, and print them when testcase end.
    endif

    comment "<N> to Default && <Y> to customize"
    config TINATEST_STRESS_STANDBY_LIMIT
        bool "LIMIT"
        default y

    if TINATEST_STRESS_STANDBY_LIMIT
        config TINATEST_STRESS_STANDBY_RUN_TIMES
            string "run_times"
            default 2
            ---help---
                The times to run testcase.
                For example:
                To run this testcase for 3 times, we can set this value as 3.

        config TINATEST_STRESS_STANDBY_RUN_ALONE
            bool "run_alone"
            default y
            ---help---
                Wait for finishing all previous testcase and run alone before do next.

        config TINATEST_STRESS_STANDBY_RUN_PARALLEL
            bool "run_parallel"
            default flase
            ---help---
                Run parallel for all run_times.
                For example:
                Testcae will run for 3 times one by one if run_times=3.
                However, if run_parallel is setted, tinatest will creates 3 processers in one time.

        config TINATEST_STRESS_STANDBY_MAY_REBOOT
            bool "may_reboot"
            default y
            ---help---
                It means that device will be rebooted while running testcase.
                All states of testcase will be saved in flash, and loaded after rebooting.
                Notices that, if may_reboot is setted, run_alone will be setted alway.

        config TINATEST_STRESS_STANDBY_TESTCASE_RUN_ONCE_TIME
            string "testcase_run_once_time"
            default ""
            ---help---
                Time limit for testcase to run once.
                It is in format:
                    <sec> <min> <hour> <day>
                For example,
                100s : 100
                1m20s : 20 1 (or 80)
                1d3h : 0 0 3 1 (or 0 0 28 or other)

        config TINATEST_STRESS_STANDBY_TESTCASE_RUN_TIME
            string "testcase_run_time"
            default ""
            ---help---
                Time limit for testcase to run.
                It is in format:
                    <sec> <min> <hour> <day>
                For example,
                100s : 100
                1m20s : 20 1 (or 80)
                1d3h : 0 0 3 1 (or 0 0 28 or other)

        choice
            prompt "timeout_with"
            default TINATEST_STRESS_STANDBY_TIMEOUT_WITH_PASS
            ---help---
                The result when testcase exit for timeout.

            config TINATEST_STRESS_STANDBY_TIMEOUT_WITH_PASS
                bool "pass"

            config TINATEST_STRESS_STANDBY_TIMEOUT_WITH_FAILED
                bool "failed"
        endchoice

        config TINATEST_STRESS_STANDBY_EXIT_ONCE_FAILED
            bool "exit_once_failed"
            default n
            ---help---
                Stop running testcase and exit once failed, even if runned times less than run_times.
    endif

    config TINATEST_STRESS_STANDBY_TEST_ROUNDS
        string "test_rounds"
        default "3"

    config TINATEST_STRESS_STANDBY_STANDBY_PERIOD_TABLE
        string "standby_period_table"
        default "50 105 130 160 120 240"

    config TINATEST_STRESS_STANDBY_RUNNING_PERIOD_TABLE
        string "running_period_table"
        default "5 15 30 60"

    config TINATEST_STRESS_STANDBY_TIMES_EACH_CASE
        string "times_each_case"
        default "5"
endif
```

## tinatest/config/sys/global/info/collectd/cpu/Config.in
```kconfig
menuconfig TINATEST_SYS_GLOBAL_INFO_COLLECTD_CPU
    bool "collectd_cpu"
    select PACKAGE_collectd-mod-cpu
    default n

if TINATEST_SYS_GLOBAL_INFO_COLLECTD_CPU
    config TINATEST_SYS_GLOBAL_INFO_COLLECTD_CPU_REPORT_TO_PERCENTAGE
        bool "report_to_percentage"
        default n
endif
```

## tinatest/config/sys/global/info/collectd/memory/Config.in
```kconfig
menuconfig TINATEST_SYS_GLOBAL_INFO_COLLECTD_MEMORY
    bool "collectd_memory"
    select PACKAGE_collectd-mod-memory
    default n

if TINATEST_SYS_GLOBAL_INFO_COLLECTD_MEMORY
    config TINATEST_SYS_GLOBAL_INFO_COLLECTD_MEMORY_REPORT_TO_ABSOLUTE
        bool "report_to_absolute"
        default n

    config TINATEST_SYS_GLOBAL_INFO_COLLECTD_MEMORY_REPORT_TO_PERCENTAGE
        bool "report_to_percentage"
        default y
endif
```

## tinatest/config/sys/global/info/collectd/rrdtool/Config.in
```kconfig
menuconfig TINATEST_SYS_GLOBAL_INFO_COLLECTD_RRDTOOL
    bool "collectd_rrdtool"
    select PACKAGE_collectd-mod-rrdtool
    default n

if TINATEST_SYS_GLOBAL_INFO_COLLECTD_RRDTOOL
    config TINATEST_SYS_GLOBAL_INFO_COLLECTD_RRDTOOL_OUTDIR
        string "outdir"
        default "/mnt/UDISK/collectd"
endif
```
